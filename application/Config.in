## application/Config.in
```kconfig
menu "Target packages"
    source "$BR2_EXTERNAL_APPLICATION_PATH/package/webctl/Config.in"
    source "$BR2_EXTERNAL_APPLICATION_PATH/package/messenger/Config.in"
    source "$BR2_EXTERNAL_APPLICATION_PATH/package/network_monitor/Config.in"
    source "$BR2_EXTERNAL_APPLICATION_PATH/package/firmware-updater/Config.in"
    source "$BR2_EXTERNAL_APPLICATION_PATH/package/qt-gui/Config.in"
    source "$BR2_EXTERNAL_APPLICATION_PATH/package/lcd-screen/Config.in"
endmenu

menu "Select the board"
    source "$BR2_EXTERNAL_APPLICATION_PATH/board/rpi3b/Config.in"
endmenu
```

## application/package/lcd-screen/Config.in
```kconfig
config BR2_PACKAGE_LCD_SCREEN
    bool "lcd-screen"
		default y
    help
      Simple GPIO kernel module for Raspberry Pi to control GPIO pins.
```

## application/package/monitor/Config.in
```kconfig
config BR2_PACKAGE_MONITOR
	bool "monitor"
    default y
	select BR2_PACKAGE_CJSON
	help
	  A generic monitoring process that reads parameters from a JSON file,
	  monitors system values, logs them, and checks thresholds.
```

## application/package/network_monitor/Config.in
```kconfig
config BR2_PACKAGE_NETWORK_MONITOR
    bool "network_monitor"
    default y
    depends on BR2_PACKAGE_JSON_C
    help
      Measures the network speed and logs it to a JSON file.

      This tool monitors the network interfaces (ethernet and wifi)
      and records the upload/download speeds in Mbps.
```

## application/package/network_speedtest/Config.in
```kconfig
config BR2_PACKAGE_NETWORK_SPEEDTEST
    bool "network_speedtest"
		default y
    help
      Measures the network speed test.
```

## application/package/qt-gui/Config.in
```kconfig
config BR2_PACKAGE_QT_GUI
    bool "qt-gui"
    default y
    select BR2_PACKAGE_QT5
    select BR2_PACKAGE_QT5DECLARATIVE
    select BR2_PACKAGE_QT5QUICKCONTROLS2
    help
      GUI with QT library
```

## application/package/webctl/Config.in
```kconfig
config BR2_PACKAGE_WEBCTL
    bool "WebCtl Package"
		default y
    depends on BR2_PACKAGE_LOGGER
    depends on BR2_PACKAGE_NODEJS
    help
      WebCtl is a package that controls tasks coming from the web and manages web files.
```
